## boards/arm/explorer_stm32_f407/Kconfig.board
```kconfig
# Kconfig - OLIMEX-STM32-E407 board configuration
#
# Copyright (c) 2017, Erwin Rol <erwin@erwinrol.com>
#
# SPDX-License-Identifier: Apache-2.0
#
config BOARD_EXPLORER_STM32_F407
	bool "BOARD_EXPLORER_STM32_F407 Development Board"
	depends on SOC_STM32F407XG
```

## boards/arm/explorer_stm32_f407/Kconfig.defconfig
```kconfig
# Kconfig - OLIMEX-STM32-E407 board configuration
#
# Copyright (c) 2017, Erwin Rol <erwin@erwinrol.com>
#
# SPDX-License-Identifier: Apache-2.0
#

if BOARD_EXPLORER_STM32_F407

config BOARD
	default "explorer_stm32_f407"

if UART_CONSOLE

config UART_1
	default y

endif # UART_CONSOLE

endif # BOARD_EXPLORER_STM32_F407
```
